## config/boards/shields/debugpad/Kconfig.defconfig
```kconfig
if SHIELD_DEBUGTEST

config ZMK_KEYBOARD_NAME
    default "DebugPad"

config BOARD_ENABLE_DCDC
  default y

config BT_CTLR
  default BT

config ZMK_BLE
  default y

config ZMK_USB
  default n

endif
```
